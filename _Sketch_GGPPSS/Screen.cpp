#include "Screen.h"

#define FIRST_SCREEN_DURATION 10000
#define SECOND_SCREEN_DURATION 3000
#define TEXT_SCREEN_DURATION 5000

#pragma region "Background images"

const unsigned char BOOT_PAGE_IMAGE[] PROGMEM =
{
    0x00, 0x00, 0x00, 0x00, 0x00, 0x00, 0x00, 0x00, 0x00, 0x00, 0x00, 0x00, 0x00, 0x00, 0x00, 0x00, 
	0x00, 0x00, 0x00, 0x00, 0x00, 0x00, 0x00, 0x00, 0x00, 0x00, 0x00, 0x00, 0x00, 0x00, 0x00, 0x00, 
	0x00, 0x00, 0x00, 0x00, 0x00, 0x00, 0x00, 0x00, 0x00, 0x00, 0x00, 0x00, 0x00, 0x00, 0x00, 0x00, 
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	0x00, 0x00, 0x00, 0x00, 0x00, 0x00, 0x00, 0x00, 0x00, 0x00, 0x00, 0x00, 0x00, 0x00, 0x00, 0x00
};

const unsigned char WAITING_PAGE_IMAGE[] PROGMEM =
{
    0x00, 0x00, 0x00, 0x00, 0x00, 0x00, 0x00, 0x00, 0x00, 0x00, 0x00, 0x00, 0x00, 0x00, 0x00, 0x00, 
	0x00, 0x00, 0x00, 0x00, 0x00, 0x00, 0x00, 0x00, 0x00, 0x00, 0x00, 0x00, 0x00, 0x00, 0x00, 0x00, 
	0x00, 0x00, 0x00, 0x00, 0x00, 0x00, 0x00, 0x00, 0x00, 0x00, 0x00, 0x00, 0x00, 0x00, 0x00, 0x00, 
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	0x00, 0x00, 0x00, 0x00, 0x00, 0x00, 0x00, 0x00, 0x00, 0x00, 0x00, 0x00, 0x00, 0x00, 0x00, 0x00
};

const unsigned char FIRST_PAGE_IMAGE[] PROGMEM =
{
    0x00, 0x00, 0x00, 0x00, 0x00, 0x00, 0x00, 0x00, 0x00, 0x00, 0x00, 0x00, 0x00, 0x00, 0x00, 0x00, 
	0x00, 0x00, 0x00, 0x00, 0x00, 0x00, 0x00, 0x00, 0x00, 0x00, 0x00, 0x00, 0x00, 0x00, 0x00, 0x00, 
	0x00, 0x00, 0x00, 0x00, 0x00, 0x00, 0x00, 0x00, 0x00, 0x00, 0x00, 0x00, 0x00, 0x00, 0x00, 0x00, 
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	0x00, 0x00, 0x00, 0x00, 0x00, 0x00, 0x00, 0x00, 0x00, 0x00, 0x00, 0x00, 0x00, 0x00, 0x00, 0x00    
};

const unsigned char SECOND_PAGE_IMAGE[] PROGMEM = 
{
    0x00, 0x00, 0x00, 0x00, 0x00, 0x00, 0x00, 0x00, 0x00, 0x00, 0x00, 0x00, 0x00, 0x00, 0x00, 0x00, 
	0x00, 0x00, 0x00, 0x00, 0x00, 0x00, 0x00, 0x00, 0x00, 0x00, 0x00, 0x00, 0x00, 0x00, 0x00, 0x00, 
	0x00, 0x00, 0x00, 0x00, 0x00, 0x00, 0x00, 0x00, 0x00, 0x00, 0x00, 0x00, 0x00, 0x00, 0x00, 0x00, 
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	0x00, 0x00, 0x00, 0x00, 0x00, 0x00, 0x00, 0x00, 0x00, 0x00, 0x00, 0x00, 0x00, 0x00, 0x00, 0x00
};

#pragma endregion

/// @brief Constructor of the class.
Display::Display()
    : _display(U8G2_R0, U8X8_PIN_NONE),
      _previousMillis(0),
      _currentScreen(EMPTY_SCREEN) {}

/// @brief Initializes display module showing boot screen.
void Display::Initialize()
{
    if (_display.begin())
    {
        _display.enableUTF8Print();

        // Display boot screen then wait 3 seconds
        this->DisplayScreen(BOOT_PAGE_SCREEN, BOOT_PAGE_IMAGE, true);
    }
    else
    {
#if DEBUG
        Serial.println(F("Display initializing... FAILED!"));
#endif
        // Stop program flow
        while (true)
        {
        }
    }
};

/// @brief Displayes a screen.
/// @param screenToDisplay Screen to be displayed.
/// @param imageToDisplay Background image to be displayed.
/// @param refreshDisplay [OPTIONAL] True to refresh display content immediatly.
void Display::DisplayScreen(Screens screenToDisplay, const unsigned char *imageToDisplay, bool refreshDisplay)
{
    if (_currentScreen != screenToDisplay)
    {
        // Clear display
        _display.clearBuffer();
        _display.drawXBMP(0, 0, 128, 64, imageToDisplay);

        // Send image to display if set
        if (refreshDisplay)
        {
            _display.sendBuffer();
        }

        _currentScreen = screenToDisplay;
    }
}

/// @brief Displayes waiting for connection screen.
void Display::DisplayWaitingScreen()
{
    // Display waiting for connection screen
    this->DisplayScreen(WAITING_PAGE_SCREEN, WAITING_PAGE_IMAGE, true);
}

/// @brief Handles timer to change screen to be displayed.
void Display::CheckScreenToDisplay()
{
    // Get current millis
    unsigned long currentMillis = millis();

    switch (_currentScreen)
    {
    case FIRST_PAGE_SCREEN:
        if (currentMillis - _previousMillis >= FIRST_SCREEN_DURATION)
        {
            // Change to second screen
            this->DisplayScreen(SECOND_PAGE_SCREEN, SECOND_PAGE_IMAGE);
            _previousMillis = currentMillis;
        }
        break;

    case SECOND_PAGE_SCREEN:
        if (currentMillis - _previousMillis >= SECOND_SCREEN_DURATION)
        {
            // Change to first screen
            this->DisplayScreen(FIRST_PAGE_SCREEN, FIRST_PAGE_IMAGE);
            _previousMillis = currentMillis;
        }
        break;

    case TEXT_PAGE_SCREEN:
        if (currentMillis - _previousMillis >= TEXT_SCREEN_DURATION)
        {
            // Change to first screen
            this->DisplayScreen(FIRST_PAGE_SCREEN, FIRST_PAGE_IMAGE);
            _previousMillis = currentMillis;
        }
        break;

    default:
        // Should never happen
        break;
    }
}

/// @brief Writes data of first screen to display.
void Display::WriteFirstScreen()
{
    // Only if data to display are changed
    if (_currentNavigationData.nextDirection != _previousNavigationData.nextDirection || _currentNavigationData.nextDirectionDistance != _previousNavigationData.nextDirectionDistance)
    {
        _display.setFont(u8g2_font_6x10_tr);

        if (_currentNavigationData.nextDirection.length() > 0)
        {
            uint16_t textWidth = _display.getStrWidth(_currentNavigationData.nextDirection.c_str());

            if (textWidth >= 128)
            {
                int bestSplit = -1;
                int center = _currentNavigationData.nextDirection.length() / 2;
                int closestDistance = _currentNavigationData.nextDirection.length();

                for (int i = 1; i < _currentNavigationData.nextDirection.length() - 1; ++i)
                {
                    if (_currentNavigationData.nextDirection[i] == ' ')
                    {
                        int distance = abs(i - center);
                        if (distance < closestDistance)
                        {
                            closestDistance = distance;
                            bestSplit = i;
                        }
                    }
                }

                if (bestSplit != -1)
                {
                    String line1 = _currentNavigationData.nextDirection.substring(0, bestSplit);
                    String line2 = _currentNavigationData.nextDirection.substring(bestSplit + 1);

                    _display.drawStr(3, 12, line1.c_str());
                    _display.drawStr(3, 26, line2.c_str());

                    _display.setFont(u8g2_font_7x14_tr);
                    _display.drawStr(3, 45, _currentNavigationData.nextDirectionDistance.c_str());
                }
                else
                {
                    _display.drawStr(3, 12, _currentNavigationData.nextDirection.c_str());
                    _display.setFont(u8g2_font_7x14_tr);
                    _display.drawStr(3, 45, _currentNavigationData.nextDirectionDistance.c_str());
                }
            }
            else
            {
                _display.drawStr(3, 12, _currentNavigationData.nextDirection.c_str());

                _display.setFont(u8g2_font_7x14_tr);
                _display.drawStr(3, 31, _currentNavigationData.nextDirectionDistance.c_str());
            }
        }

        _previousNavigationData.nextDirection = _currentNavigationData.nextDirection;
        _previousNavigationData.nextDirectionDistance = _currentNavigationData.nextDirectionDistance;
    }
}

/// @brief Writes data of second screen to display.
void Display::WriteSecondScreen()
{
    // Only if data to display are changed
    if (_currentNavigationData.arrivalTime != _previousNavigationData.arrivalTime || _currentNavigationData.leftData != _previousNavigationData.leftData)
    {
        _display.setFont(u8g2_font_5x7_tr);
        _display.drawStr(3, 28, _currentNavigationData.arrivalTime.c_str());
        _display.drawStr(3, 48, _currentNavigationData.leftData.c_str());

        _previousNavigationData.arrivalTime = _currentNavigationData.arrivalTime;
        _previousNavigationData.leftData = _currentNavigationData.leftData;
    }
}

/// @brief Write notification data to display.
void Display::DisplayNavigationData()
{
    this->CheckScreenToDisplay();

    switch (_currentScreen)
    {
    case FIRST_PAGE_SCREEN:
        this->WriteFirstScreen();
        break;

    case SECOND_PAGE_SCREEN:
        this->WriteSecondScreen();
        break;

    default:
        break;
    }

    _display.sendBuffer();
}

/// @brief Updates navigation data to be displayed.
/// @param navigationData Updated navigation data.
void Display::UpdateNavigationData(NAVIGATION_DATA navigationData)
{
    _currentNavigationData = navigationData;

    if (!navigationData.isValid)
    {
        this->WriteText("Received not valid data...");
    }
}

/// @brief Write text to display.
/// @param text Text to be displayed.
/// @param x X position of the text on screen.
/// @param y Y position of the text on screen.
/// @param direction Direction of the text.
void Display::WriteText(String text, int x, int y, Direction direction)
{
    // Refresh previous millis to make timer working.
    _previousMillis = millis();

    _display.clearBuffer();
    _display.setFontDirection(int(direction));
    _display.setFont(u8g2_font_5x7_tr);

    _display.drawStr(x, y, text.c_str());
    _display.sendBuffer();

    _currentScreen = TEXT_PAGE_SCREEN;
}
